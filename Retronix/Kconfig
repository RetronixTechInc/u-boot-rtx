## Retronix/Kconfig
```kconfig
if ARCH_MX6

menu "Retronix"
choice
	prompt "Retronix board select"
	optional

config TARGET_RTX_Q7_B10
	bool "Retronix Q7 B10"
	select BOARD_LATE_INIT
	select MX6Q
	select SUPPORT_SPL
	select DM
	select DM_THERMAL
	select BOARD_EARLY_INIT_F

config TARGET_RTX_A6PLUS_B10
	bool "Retronix A6 Plus B10"
	select BOARD_LATE_INIT
	select MX6Q
	select SUPPORT_SPL
	select DM
	select DM_THERMAL
	select BOARD_EARLY_INIT_F

config TARGET_RTX_PICO_B10
	bool "Retronix PICO B10"
	select BOARD_LATE_INIT
	select MX6Q
	select SUPPORT_SPL
	select DM
	select DM_THERMAL
	select BOARD_EARLY_INIT_F

config TARGET_RTX_PICO_B21
	bool "Retronix PICO B21"
	select BOARD_LATE_INIT
	select MX6Q
	select SUPPORT_SPL
	select DM
	select DM_THERMAL
	select BOARD_EARLY_INIT_F

endchoice

config RTX_ANDROID_SUPPORT
	bool "Android Support"
	default n

source "Retronix/board/rtx_q7_mx6q_b10/Kconfig"
source "Retronix/board/rtx_a6plus_mx6q_b10/Kconfig"
source "Retronix/board/rtx_pico_mx6q_b10/Kconfig"
source "Retronix/board/rtx_pico_mx6q_b21/Kconfig"
source "Retronix/board/rtx_ddr/Kconfig"
source "Retronix/board/rtx_common/Kconfig"
source "Retronix/drivers/Kconfig"

endmenu

endif
```

## Retronix/board/rtx_a6plus_mx6q_b10/Kconfig
```kconfig
if TARGET_RTX_A6PLUS_B10

config SYS_BOARD
	default "rtx_a6plus_mx6q_b10"

config SYS_VENDOR
	default "../Retronix/board"

config SYS_CONFIG_NAME
	default "../../Retronix/include/configs/rtx_a6plus_mx6q_b10"

endif
```

## Retronix/board/rtx_common/Kconfig
```kconfig
menu "Retronix Zero Partition Memory Map and Size"

	config RTX_PARTITION_BLOCK_SIZE
		hex "Read/Write Block Size"
		default 0x200

	config RTX_PARTITION_0_MBR_OFFSET
		hex "MBR Offset"
		default 0

	config RTX_PARTITION_0_MBR_SIZE
		hex "MBR Sizes"
		default 0x2

	config RTX_PARTITION_0_UBOOT_OFFSET
		hex "Boot Loader Offset"
		default 0x2

	config RTX_PARTITION_0_UBOOT_SIZE
		hex "Boot Loader Sizes"
		default 0x5FE

	config RTX_PARTITION_0_DATA_OFFSET
		hex "Data Offset"
		default 0x600

	config RTX_PARTITION_0_DATA_SIZE
		hex "Data Size"
		default 0x2

	config RTX_PARTITION_0_RECOVERY_KERNEL_OFFSET
		hex "Recovery Kernel Offset"
		default 0x800

	config RTX_PARTITION_0_RECOVERY_KERNEL_SIZE
		hex "Recovery Kernel Size"
		default 0x5400
		
	config RTX_PARTITION_0_RECOVERY_KERNEL_DTB_OFFSET
		hex "Recovery Kernel DTB Offset"
		default 0x5C00

	config RTX_PARTITION_0_RECOVERY_KERNEL_DTB_SIZE
		hex "Recovery Kernel DTB Size"
		default 0x400

	config RTX_PARTITION_0_UBOOT_ARGUMENT_OFFSET
		hex "U-Boot Argument Offset"
		default 0x6000

	config RTX_PARTITION_0_UBOOT_ARGUMENT_SIZE
		hex "U-Boot Argument Size"
		default 0x400

	config RTX_PARTITION_0_KERNEL_DTB_OFFSET
		hex "Kernel DTB Offset"
		default 0x6400

	config RTX_PARTITION_0_KERNEL_DTB_SIZE
		hex "Kernel DTB Size"
		default 0x400

	config RTX_PARTITION_0_KERNEL_OFFSET
		hex "Kernel Offset"
		default 0x6800

	config RTX_PARTITION_0_KERNEL_SIZE
		hex "Kernel Size"
		default 0x5800

	config RTX_PARTITION_0_RAM_DISK0_OFFSET
		hex "Android Root Filesystem Offset"
		default 0xC000
		help
			for android boot ram disk

	config RTX_PARTITION_0_RAM_DISK0_SIZE
		hex "Android Root Filesystem Size"
		default 0x1000

	config RTX_PARTITION_0_RAM_DISK1_OFFSET
		hex "Android Recovery Root Filesystem Offset"
		default 0xD000
		help
			for android recovery ram disk

	config RTX_PARTITION_0_RAM_DISK1_SIZE
		hex "Android Recovery Root Filesystem Size"
		default 0x2000

	config RTX_PARTITION_0_RAM_DISK2_OFFSET
		hex "Mini. Root Filesystem Offset"
		default 0xF000
		help
			for update ram disk

	config RTX_PARTITION_0_RAM_DISK2_SIZE
		hex "Mini. Root Filesystem Size"
		default 0x5000

	config RTX_PARTITION_0_LOGO_OFFSET
		hex "Logo Image Offset"
		default 0x1E000

	config RTX_PARTITION_0_LOGO_SIZE
		hex "Logo Image Size"
		default 0x2000

	config RTX_PARTITION_0_MAX_SIZE
		hex "Max Size"
		default 0x20000

endmenu

menu "Retronix Loader Memory Map"

	config RTX_LOADADDR
		hex "Loading Address for Kernel"
		default 0x10800000

	config RTX_LOADADDR_DTB
		hex "Loading Address for Kernel DTB"
		default 0x11C00000
	
	config RTX_LOADADDR_RD
		hex "Loading Address for Ram Disk"
		default 0x11D00000

endmenu

menu "Retronix Debug Port"
	config RTX_DEBUG_UART_PORT
		int "Debug Uart Port (0~4)"
		default 0
endmenu

menu "U-Boot Environment"

	menu "Android"
		depends on RTX_ANDROID_SUPPORT
		config ANDROID_RECOVERY_BOOTARGS
			string 
		config ANDROID_RECOVERY_BOOTCMD
			string 
	endmenu

	menu "Display"
		comment "Select output interface"
		config RTX_BOOT_ARGS_VGA_EN
			bool "Enable VGA argument"
			default n

		config RTX_BOOT_ARGS_HDMI_EN
			bool "Enable HDMI argument"
			default n	

		config RTX_BOOT_ARGS_LVDS0_EN
			bool "Enable LVDS0 argument"
			default n	

		config RTX_BOOT_ARGS_LVDS1_EN
			bool "Enable LVDS1 argument"
			default n
		
		comment "The output interface argument"
		
		config RTX_BOOT_ARGS_VGA
			depends on RTX_BOOT_ARGS_VGA_EN
			string "VGA argument"
			default "1024x768@60,if=RGB24,bpp=32"

		config RTX_BOOT_ARGS_HDMI
			depends on RTX_BOOT_ARGS_HDMI_EN
			string "HDMI argument"
			default "1920x1080M@60,if=RGB24,bpp=32"

		config RTX_BOOT_ARGS_LVDS0
			depends on RTX_BOOT_ARGS_LVDS0_EN
			string "LVDS0 argument"
			default "1024x768@60,if=RGB24,bpp=32"

		config RTX_BOOT_ARGS_LVDS1
			depends on RTX_BOOT_ARGS_LVDS1_EN
			string "LVDS1"
			default "1024x768@60,if=RGB24,bpp=32"
		
		comment "Set Video argument"
		
		choice
			prompt "Video 1 select"
			default RTX_BOOT_ARGS_VIDEO1_SEL_NONE

			config RTX_BOOT_ARGS_VIDEO1_SEL_NONE
				bool "None"
			
			config RTX_BOOT_ARGS_VIDEO1_SEL_VGA
				depends on RTX_BOOT_ARGS_VGA_EN
				bool "VGA"

			config RTX_BOOT_ARGS_VIDEO1_SEL_HDMI
				depends on RTX_BOOT_ARGS_HDMI_EN
				bool "HDMI"

			config RTX_BOOT_ARGS_VIDEO1_SEL_LVDS0
				depends on RTX_BOOT_ARGS_LVDS0_EN
				bool "LVDS0"

			config RTX_BOOT_ARGS_VIDEO1_SEL_LVDS1
				depends on RTX_BOOT_ARGS_LVDS1_EN
				bool "LVDS1"

		endchoice
		
		config RTX_BOOT_ARGS_VIDEO1
			int 
			default 0 if RTX_BOOT_ARGS_VIDEO1_SEL_NONE
			default 1 if RTX_BOOT_ARGS_VIDEO1_SEL_VGA
			default 2 if RTX_BOOT_ARGS_VIDEO1_SEL_HDMI
			default 3 if RTX_BOOT_ARGS_VIDEO1_SEL_LVDS0
			default 4 if RTX_BOOT_ARGS_VIDEO1_SEL_LVDS1

		choice
			prompt "Video 2 select"
			default RTX_BOOT_ARGS_VIDEO2_SEL_NONE

			config RTX_BOOT_ARGS_VIDEO2_SEL_NONE
				bool "None"
			
			config RTX_BOOT_ARGS_VIDEO2_SEL_VGA
				depends on RTX_BOOT_ARGS_VGA_EN
				bool "VGA"

			config RTX_BOOT_ARGS_VIDEO2_SEL_HDMI
				depends on RTX_BOOT_ARGS_HDMI_EN
				bool "HDMI"

			config RTX_BOOT_ARGS_VIDEO2_SEL_LVDS0
				depends on RTX_BOOT_ARGS_LVDS0_EN
				bool "LVDS0"

			config RTX_BOOT_ARGS_VIDEO2_SEL_LVDS1
				depends on RTX_BOOT_ARGS_LVDS1_EN
				bool "LVDS1"

		endchoice
		
		config RTX_BOOT_ARGS_VIDEO2
			int 
			default 0 if RTX_BOOT_ARGS_VIDEO2_SEL_NONE
			default 1 if RTX_BOOT_ARGS_VIDEO2_SEL_VGA
			default 2 if RTX_BOOT_ARGS_VIDEO2_SEL_HDMI
			default 3 if RTX_BOOT_ARGS_VIDEO2_SEL_LVDS0
			default 4 if RTX_BOOT_ARGS_VIDEO2_SEL_LVDS1

		choice
			prompt "Video 3 select"
			default RTX_BOOT_ARGS_VIDEO3_SEL_NONE

			config RTX_BOOT_ARGS_VIDEO3_SEL_NONE
				bool "None"
			
			config RTX_BOOT_ARGS_VIDEO3_SEL_VGA
				depends on RTX_BOOT_ARGS_VGA_EN
				bool "VGA"

			config RTX_BOOT_ARGS_VIDEO3_SEL_HDMI
				depends on RTX_BOOT_ARGS_HDMI_EN
				bool "HDMI"

			config RTX_BOOT_ARGS_VIDEO3_SEL_LVDS0
				depends on RTX_BOOT_ARGS_LVDS0_EN
				bool "LVDS0"

			config RTX_BOOT_ARGS_VIDEO3_SEL_LVDS1
				depends on RTX_BOOT_ARGS_LVDS1_EN
				bool "LVDS1"

		endchoice
		
		config RTX_BOOT_ARGS_VIDEO3
			int 
			default 0 if RTX_BOOT_ARGS_VIDEO3_SEL_NONE
			default 1 if RTX_BOOT_ARGS_VIDEO3_SEL_VGA
			default 2 if RTX_BOOT_ARGS_VIDEO3_SEL_HDMI
			default 3 if RTX_BOOT_ARGS_VIDEO3_SEL_LVDS0
			default 4 if RTX_BOOT_ARGS_VIDEO3_SEL_LVDS1

	endmenu

	menu "Memory"
		config RTX_BOOT_ARGS_VMALLOC
			int "vmalloc size (?M)"
			default 400

		config RTX_BOOT_ARGS_GPU_MEM
			int "GPU memory size (?M)"
			default 175

	endmenu
	
	menu "Ethernet MAC"
		config RTX_BOOT_ARGS_DEFAULT_MAC01
			string "Default MAC 1 Address"
			default "1E:ED:19:27:1A:B3"

		config RTX_BOOT_ARGS_DEFAULT_MAC02
			string "Default MAC 2 Address"
			default "1E:ED:19:27:1A:B4"
	endmenu

	menu "Storage"
		config RTX_BOOT_ARGS_ROOTFS_MMC_NUM
			int "Root file system emmc storage usdhc number"
			default 0
			help
				0 : usdhc4
				1 : usdhc3
				2 : usdhc2
				3 : usdhc1

		config RTX_BOOT_ARGS_ROOTFS_PARTITION
			int "Root file system partition number"
			default 1

	endmenu

endmenu
```

## Retronix/board/rtx_ddr/Kconfig
```kconfig
menu "Memory Select"

choice
	prompt "DDR Data Bus Width"
	default RTX_DDR_DATA_WIDTH_64
	
	config RTX_DDR_DATA_WIDTH_16
		bool "16"

	config RTX_DDR_DATA_WIDTH_32
		bool "32"

	config RTX_DDR_DATA_WIDTH_64
		bool "64"

endchoice

choice
	prompt "DDR Chip Select"
	default RTX_DDR_IS_MICRO_MT41K128M16
	
	config RTX_DDR_IS_MICRO_MT41K128M16
		bool "MT41K128M16(Micro,etc)"
	
	config RTX_DDR_IS_MICRO_MT41K256M16
		bool "MT41K256M16(Micro)"

	config RTX_DDR_IS_SAMSUNG_K4B4G1646DBYK0256M16
		bool "K4B4G1646DBYK0(Samsung)"	

endchoice

endmenu
```

## Retronix/board/rtx_pico_mx6q_b10/Kconfig
```kconfig
if TARGET_RTX_PICO_B10

config SYS_BOARD
	default "rtx_pico_mx6q_b10"

config SYS_VENDOR
	default "../Retronix/board"

config SYS_CONFIG_NAME
	default "../../Retronix/include/configs/rtx_pico_mx6q_b10"

endif
```

## Retronix/board/rtx_pico_mx6q_b21/Kconfig
```kconfig
if TARGET_RTX_PICO_B21

config SYS_BOARD
	default "rtx_pico_mx6q_b21"

config SYS_VENDOR
	default "../Retronix/board"

config SYS_CONFIG_NAME
	default "../../Retronix/include/configs/rtx_pico_mx6q_b21"

endif
```

## Retronix/board/rtx_q7_mx6q_b10/Kconfig
```kconfig
if TARGET_RTX_Q7_B10

config SYS_BOARD
	default "rtx_q7_mx6q_b10"

config SYS_VENDOR
	default "../Retronix/board"

config SYS_CONFIG_NAME
	default "../../Retronix/include/configs/rtx_q7_mx6q_b10"

endif
```

## Retronix/board/rtx_valor_mx6dl_111/Kconfig
```kconfig
if TARGET_RTX_VALOR_111

config SYS_BOARD
	default "rtx_valor_mx6dl_111"

config SYS_VENDOR
	default "../Retronix/board"

config SYS_CONFIG_NAME
	default "../../Retronix/include/configs/rtx_valor_mx6dl_111"

endif
```

## Retronix/configs/rtx_pico_b10_imx6q_1g_defconfig
```kconfig
CONFIG_ARM=y
CONFIG_ARCH_MX6=y
CONFIG_SPL_GPIO_SUPPORT=y
CONFIG_SPL_LIBCOMMON_SUPPORT=y
CONFIG_SPL_LIBGENERIC_SUPPORT=y
CONFIG_SPL_MMC_SUPPORT=y
CONFIG_SPL_SERIAL_SUPPORT=y
CONFIG_SPL_LIBDISK_SUPPORT=y
CONFIG_SPL_WATCHDOG_SUPPORT=y
# CONFIG_SPL_USB_HOST_SUPPORT is not set
# CONFIG_SPL_USB_SUPPORT is not set
# CONFIG_VIDEO is not set
CONFIG_SYS_EXTRA_OPTIONS="IMX_CONFIG=arch/arm/imx-common/spl_sd.cfg,SPL,MX6QDL"
CONFIG_BOOTDELAY=3
# CONFIG_CONSOLE_MUX is not set
CONFIG_SYS_CONSOLE_IS_IN_ENV=y
CONFIG_SYS_CONSOLE_OVERWRITE_ROUTINE=y
CONFIG_SPL=y
# CONFIG_SPL_FAT_SUPPORT is not set
CONFIG_SPL_EXT_SUPPORT=y
CONFIG_SPL_I2C_SUPPORT=y
CONFIG_SPL_OS_BOOT=y
CONFIG_HUSH_PARSER=y
CONFIG_CMD_BOOTZ=y
# CONFIG_CMD_IMLS is not set
# CONFIG_CMD_FLASH is not set
CONFIG_CMD_MMC=y
CONFIG_CMD_SF=y
CONFIG_CMD_I2C=y
CONFIG_CMD_USB=y
CONFIG_CMD_GPIO=y
CONFIG_CMD_DHCP=y
CONFIG_CMD_MII=y
CONFIG_CMD_PING=y
CONFIG_CMD_CACHE=y
CONFIG_CMD_EXT2=y
CONFIG_CMD_EXT4=y
CONFIG_CMD_EXT4_WRITE=y
CONFIG_CMD_FAT=y
CONFIG_CMD_FS_GENERIC=y
CONFIG_SPI_FLASH=y
CONFIG_SPI_FLASH_STMICRO=y
# CONFIG_PCI is not set
CONFIG_USB=y
CONFIG_USB_STORAGE=y
CONFIG_USB_GADGET=y
CONFIG_CI_UDC=y
CONFIG_USB_GADGET_DOWNLOAD=y
CONFIG_G_DNL_MANUFACTURER="FSL"
CONFIG_G_DNL_VENDOR_NUM=0x0525
CONFIG_G_DNL_PRODUCT_NUM=0xa4a5
# CONFIG_VIDEO_SW_CURSOR is not set
CONFIG_OF_LIBFDT=y


#
# Retronix
#
CONFIG_TARGET_RTX_PICO_B10=y
# CONFIG_TARGET_RTX_PICO_B21 is not set
# CONFIG_RTX_ANDROID_SUPPORT is not set

#
# Memory DDR Chip Select
#
CONFIG_RTX_DDR_IS_MICRO_MT41K128M16=y
# CONFIG_RTX_DDR_IS_MICRO_MT41K256M16 is not set

#
# Retronix Zero Partition Memory Map and Size
#
CONFIG_RTX_PARTITION_BLOCK_SIZE=0x200
CONFIG_RTX_PARTITION_0_MBR_OFFSET=0
CONFIG_RTX_PARTITION_0_MBR_SIZE=0x2
CONFIG_RTX_PARTITION_0_UBOOT_OFFSET=0x2
CONFIG_RTX_PARTITION_0_UBOOT_SIZE=0x5FE
CONFIG_RTX_PARTITION_0_DATA_OFFSET=0x600
CONFIG_RTX_PARTITION_0_DATA_SIZE=0x2
CONFIG_RTX_PARTITION_0_RECOVERY_KERNEL_OFFSET=0x800
CONFIG_RTX_PARTITION_0_RECOVERY_KERNEL_SIZE=0x5400
CONFIG_RTX_PARTITION_0_RECOVERY_KERNEL_DTB_OFFSET=0x5C00
CONFIG_RTX_PARTITION_0_RECOVERY_KERNEL_DTB_SIZE=0x400
CONFIG_RTX_PARTITION_0_UBOOT_ARGUMENT_OFFSET=0x6000
CONFIG_RTX_PARTITION_0_UBOOT_ARGUMENT_SIZE=0x400
CONFIG_RTX_PARTITION_0_KERNEL_DTB_OFFSET=0x6400
CONFIG_RTX_PARTITION_0_KERNEL_DTB_SIZE=0x400
CONFIG_RTX_PARTITION_0_KERNEL_OFFSET=0x6800
CONFIG_RTX_PARTITION_0_KERNEL_SIZE=0x5800
CONFIG_RTX_PARTITION_0_RAM_DISK0_OFFSET=0xC000
CONFIG_RTX_PARTITION_0_RAM_DISK0_SIZE=0x1000
CONFIG_RTX_PARTITION_0_RAM_DISK1_OFFSET=0xD000
CONFIG_RTX_PARTITION_0_RAM_DISK1_SIZE=0x2000
CONFIG_RTX_PARTITION_0_RAM_DISK2_OFFSET=0xF000
CONFIG_RTX_PARTITION_0_RAM_DISK2_SIZE=0x5000
CONFIG_RTX_PARTITION_0_LOGO_OFFSET=0x1E000
CONFIG_RTX_PARTITION_0_LOGO_SIZE=0x2000
CONFIG_RTX_PARTITION_0_MAX_SIZE=0x20000

#
# Retronix Loader Memory Map
#
CONFIG_RTX_LOADADDR=0x10800000
CONFIG_RTX_LOADADDR_DTB=0x11C00000
CONFIG_RTX_LOADADDR_RD=0x11D00000

#
# Retronix Debug Port
#
CONFIG_RTX_DEBUG_UART_PORT=1

#
# U-Boot Environment
#

#
# Display
#

#
# Select output interface
#
CONFIG_RTX_BOOT_ARGS_VGA_EN=y
CONFIG_RTX_BOOT_ARGS_HDMI_EN=y
CONFIG_RTX_BOOT_ARGS_LVDS0_EN=y
CONFIG_RTX_BOOT_ARGS_LVDS1_EN=y

#
# The output interface argument
#
CONFIG_RTX_BOOT_ARGS_VGA="1024x768@60,if=RGB24,bpp=32"
CONFIG_RTX_BOOT_ARGS_HDMI="1920x1080M@60,if=RGB24,bpp=32"
CONFIG_RTX_BOOT_ARGS_LVDS0="1024x768@60,if=RGB24,bpp=32"
CONFIG_RTX_BOOT_ARGS_LVDS1="1024x768@60,if=RGB24,bpp=32"

#
# Set Video argument
#
# CONFIG_RTX_BOOT_ARGS_VIDEO1_SEL_NONE is not set
# CONFIG_RTX_BOOT_ARGS_VIDEO1_SEL_VGA is not set
CONFIG_RTX_BOOT_ARGS_VIDEO1_SEL_HDMI=y
# CONFIG_RTX_BOOT_ARGS_VIDEO1_SEL_LVDS0 is not set
# CONFIG_RTX_BOOT_ARGS_VIDEO1_SEL_LVDS1 is not set
CONFIG_RTX_BOOT_ARGS_VIDEO1=2
CONFIG_RTX_BOOT_ARGS_VIDEO2_SEL_NONE=y
# CONFIG_RTX_BOOT_ARGS_VIDEO2_SEL_VGA is not set
# CONFIG_RTX_BOOT_ARGS_VIDEO2_SEL_HDMI is not set
# CONFIG_RTX_BOOT_ARGS_VIDEO2_SEL_LVDS0 is not set
# CONFIG_RTX_BOOT_ARGS_VIDEO2_SEL_LVDS1 is not set
CONFIG_RTX_BOOT_ARGS_VIDEO2=0
CONFIG_RTX_BOOT_ARGS_VIDEO3_SEL_NONE=y
# CONFIG_RTX_BOOT_ARGS_VIDEO3_SEL_VGA is not set
# CONFIG_RTX_BOOT_ARGS_VIDEO3_SEL_HDMI is not set
# CONFIG_RTX_BOOT_ARGS_VIDEO3_SEL_LVDS0 is not set
# CONFIG_RTX_BOOT_ARGS_VIDEO3_SEL_LVDS1 is not set
CONFIG_RTX_BOOT_ARGS_VIDEO3=0

#
# Memory
#
CONFIG_RTX_BOOT_ARGS_VMALLOC=400
CONFIG_RTX_BOOT_ARGS_GPU_MEM=175

#
# Ethernet MAC
#
CONFIG_RTX_BOOT_ARGS_DEFAULT_MAC01="1E:ED:19:27:1A:B3"
CONFIG_RTX_BOOT_ARGS_DEFAULT_MAC02="1E:ED:19:27:1A:B4"

#
# Storage
#
CONFIG_RTX_BOOT_ARGS_ROOTFS_MMC_NUM=1
CONFIG_RTX_BOOT_ARGS_ROOTFS_PARTITION=1

#
# Retronix Watchdog
#
CONFIG_RTX_EFM32=y

#
# Retronix Watchdog Options
#
CONFIG_RTX_EFM32_I2C_BUS=2
CONFIG_RTX_EFM32_WATCHDOG_TIME=0

#
# Retronix Boot System
#
CONFIG_RTX_BOOT_SYSTEM=y

#
# Boot System Options
#
CONFIG_RTX_BOOT_SYSTEM_MAX_EXTSD=4

#
# Function Select
#
# CONFIG_RTX_BOOT_SYSTEM_OPTIONS_FUNC_PASSWORD is not set
# CONFIG_RTX_BOOT_SYSTEM_OPTIONS_FUNC_CHANG_PW is not set
# CONFIG_RTX_BOOT_SYSTEM_OPTIONS_FUNC_CHG_STORAGE is not set
CONFIG_RTX_BOOT_SYSTEM_OPTIONS_FUNC_MENU=y
CONFIG_RTX_BOOT_SYSTEM_OPTIONS_FUNC_UD_EXTSD=y
CONFIG_RTX_BOOT_SYSTEM_OPTIONS_FUNC_UD_USB=y
CONFIG_RTX_BOOT_SYSTEM_OPTIONS_FUNC_SCANFILE_SELF=y

#
# Extern Command
#
CONFIG_RTX_BOOT_CMD_RESET_ENV=y
CONFIG_RTX_BOOT_CMD_RESET_SETTING=y
CONFIG_RTX_BOOT_SYSTEM_SHOW_SETTING_INFO=y
```
