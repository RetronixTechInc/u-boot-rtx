## Retronix/drivers/efm32/Kconfig
```kconfig
menu "Retronix Watchdog"
	config RTX_EFM32
		bool "Retronix EFM32 Watchdog"
		default n

		menu "Retronix Watchdog Options"
			depends on RTX_EFM32

			config RTX_EFM32_I2C_BUS
				int "I2C Bus Number"
				default 2

			config RTX_EFM32_WATCHDOG_TIME
				int "Watch dog default time"
				default 120

		endmenu
endmenu
```

## Retronix/drivers/rtx/Kconfig
```kconfig
menu "Retronix Boot System"

	config RTX_BOOT_SYSTEM
		bool "Retronix Boot System"
		default n

	menu "Boot System Options"
		config RTX_BOOT_SYSTEM_MAX_EXTSD
			depends on RTX_BOOT_SYSTEM
			int "Max. SD Card"
			default 4

		menu "Function Select"
			depends on RTX_BOOT_SYSTEM

			config RTX_BOOT_SYSTEM_OPTIONS_FUNC_PASSWORD
				bool "Password"
				default n

			config RTX_BOOT_SYSTEM_OPTIONS_FUNC_CHANG_PW
				bool "Change Password"
				default n

			config RTX_BOOT_SYSTEM_OPTIONS_FUNC_CHG_STORAGE
				bool "Auto change storage"
				default n

			config RTX_BOOT_SYSTEM_OPTIONS_FUNC_MENU
				bool "Boot menu"
				default n

			config RTX_BOOT_SYSTEM_OPTIONS_FUNC_UD_EXTSD
				bool "Update from SD Card"
				default n

			config RTX_BOOT_SYSTEM_OPTIONS_FUNC_UD_USB
				bool "Update from U-DIsk"
				default n

			config RTX_BOOT_SYSTEM_OPTIONS_FUNC_SCANFILE_SELF
				bool "Check Magic code from boot storage"
				default n

		endmenu

		menu "Extern Command"

			config RTX_BOOT_CMD_RESET_ENV
				bool "Reset U-Boot Environment"
				default n

			config RTX_BOOT_CMD_RESET_SETTING
				bool "Reset Retronix data"
				default n

			config RTX_BOOT_SYSTEM_SHOW_SETTING_INFO
				bool "Dump Retronix data"
				default n
		endmenu

	endmenu
endmenu
```

## board/freescale/imx8mm_cse/Kconfig
```kconfig
if TARGET_IMX8MM_CSE || TARGET_IMX8MM_DDR4_CSE

config SYS_BOARD
	default "imx8mm_cse"

config SYS_VENDOR
	default "freescale"

config SYS_CONFIG_NAME
	default "imx8mm_cse"

config IMX_CONFIG
	default "board/freescale/imx8mm_cse/imximage-8mm.cfg"

config IMX8M_1G_MEMORY
	bool "imx8m 1GB memory size"

source "board/freescale/common/Kconfig"

endif
```

## board/freescale/imx8mm_evk/Kconfig
```kconfig
if TARGET_IMX8MM_EVK || TARGET_IMX8MM_DDR4_EVK

config SYS_BOARD
	default "imx8mm_evk"

config SYS_VENDOR
	default "freescale"

config SYS_CONFIG_NAME
	default "imx8mm_evk"

config EXTRA_ENV_USE_DTB
	bool "kernel is dtb type."
	default y
	help
	  Kernel has DTB.

config DEF_LOADADDR
	hex "loadaddr"
	default "0x40480000"
	help
	  loadaddr.

config DTB_LOADADDR
	hex "dtb_loadaddr"
	default "0x43000000"
	help
	  dtb_loadaddr.

config RD_LOADADDR
	hex "rd_loadaddr"
	default "0x43800000"
	help
	  rd_loadaddr.

config SYS_TEXT_BASE
	hex "system text loadaddr address"
	default "0x27800000"
	help
	  SYS_TEXT_BASE.


config BOOTSEL_FUNC_PASSWORD
	bool "Bootsel password function."
	default n
	help
	  Uboot passwork funciton.

config BOOTSEL_FUNC_CHANG_PW
	bool "Bootsel change password function."
	default n
	help
	  Uboot change passwork funciton.

config BOOTSEL_FUNC_UD_EXTSD
	bool "Bootsel scan extsd function."
	default n
	help
	  Uboot scan external sd card magic code funciton.

config BOOTSEL_FUNC_UD_USB
	bool "Bootsel scan usb function."
	default n
	help
	  Uboot scan usb storage magic code funciton.

config BOOTSEL_FUNC_MENU
	bool "Bootsel menu function."
	default n
	help
	  Uboot munu funciton.It is u/U, r/R, a/A and p/P mode.
	  u/U mode : roption is update.
	  r/R mode : roption is recovery.
	  a/A mode : this is android recovery mode.
	  p/P mode : this is change password mode.

config BOOTSEL_FUNC_CHG_STORAGE
	bool "Bootsel autodetect storage function."
	default n
	help
	  Uboot autodetect upstart device number funciton.
	  usdhc1 is unknow.
	  usdhc2 is mmcblk2
	  usdhc3 is mmcblk1
	  usdhc4 is mmcblk0

config BOOTSEL_FUNC_SCANFILE_SELF
	bool "Bootsel scan self function."
	default n
	help
	  Uboot scan self magic code funciton.

config MCU_WATCHDOG_TIME
	hex "uboot to os start-up time."
	default "0"
	help
	  uboot to os start-up time.disable if set is 0.

source "board/freescale/common/Kconfig"

endif
```

## board/freescale/mx6sabresd/Kconfig
```kconfig
if TARGET_MX6SABRESD

config SYS_BOARD
	default "mx6sabresd"

config SYS_VENDOR
	default "freescale"

config SYS_CONFIG_NAME
	default "mx6sabresd"

config SYS_TEXT_BASE
    default 0x17800000

config BOOTARGS_GEN
	string "bootagrs parameter"
	default "init=/init"
	help
	  bootargs parameter.
	  
config DEFAULT_MAC02
	string "mac02 default address"
	default "06:67:ba:04:fd:44"
	help
	  smsc mac default address.

config DEFAULT_MAC01
	string "mac01 default address"
	default "1E:ED:19:27:1A:B3"
	help
	  MAC address.

config CONSOLE_DEV
	string "console port"
	default "ttymxc1"
	help
	  debug port.

config GUIPORT
	string "GUI port"
	default "hdmi"
	help
	  GUI port hdmi,vga or dual-hdmi.

config BOOTARGS_HDMI
	string "hdmi gui parameter"
	default "video=mxcfb0:dev=hdmi,1920x1080M@60,if=RGB24,bpp=32 video=mxcfb1:off video=mxcfb2:off"
	help
	  GUI port hdmi.

config BOOTARGS_APP
	string "bootargs append"
	default ""
	help
	  bootargs append

config DEF_LOADADDR
	hex "loadaddr"
	default "0x10800000"
	help
	  loadaddr.

config DTB_LOADADDR
	hex "dtb_loadaddr"
	default "0x11C00000"
	help
	  dtb_loadaddr.

config RD_LOADADDR
	hex "rd_loadaddr"
	default "0x11D00000"
	help
	  rd_loadaddr.

config BOOTSEL_FUNC_PASSWORD
	bool "Bootsel password function."
	default n
	help
	  Uboot passwork funciton.

config BOOTSEL_FUNC_CHANG_PW
	bool "Bootsel change password function."
	default n
	help
	  Uboot change passwork funciton.

config BOOTSEL_FUNC_UD_EXTSD
	bool "Bootsel scan extsd function."
	default n
	help
	  Uboot scan external sd card magic code funciton.

config BOOTSEL_FUNC_UD_USB
	bool "Bootsel scan usb function."
	default n
	help
	  Uboot scan usb storage magic code funciton.

config BOOTSEL_FUNC_MENU
	bool "Bootsel menu function."
	default n
	help
	  Uboot munu funciton.It is u/U, r/R, a/A and p/P mode.
	  u/U mode : roption is update.
	  r/R mode : roption is recovery.
	  a/A mode : this is android recovery mode.
	  p/P mode : this is change password mode.

config UPDATEROOT
	string "update mount path"
	default "/dev/mmcblk1p1"
	help
	  update and reovery filesystem mount path.

config BOOTSEL_FUNC_CHG_STORAGE
	bool "Bootsel autodetect storage function."
	default n
	help
	  Uboot autodetect upstart device number funciton.
	  usdhc1 is unknow.
	  usdhc2 is mmcblk2
	  usdhc3 is mmcblk1
	  usdhc4 is mmcblk0

config BOOTSEL_FUNC_SCANFILE_SELF
	bool "Bootsel scan self function."
	default n
	help
	  Uboot scan self magic code funciton.

config MCU_WATCHDOG_TIME
	hex "uboot to os start-up time."
	default "0"
	help
	  uboot to os start-up time.disable if set is 0.

endif
```

## board/retronix/Kconfig
```kconfig
source "board/retronix/rtx_adlink_mx6dl/Kconfig"
source "board/retronix/rtx_a6plus_mx6q/Kconfig"
source "board/retronix/rtx_a6_mx6q/Kconfig"
source "board/retronix/rtx_pitx_mx6q/Kconfig"
source "board/retronix/rtx_q7_mx6q/Kconfig"
source "board/retronix/rtx-valor111-plus-mx6dl/Kconfig"
source "board/retronix/rtx-treadmill-mx6q/Kconfig"
```

## board/retronix/configs/Kconfig
```kconfig
config TARGET_RTX_ADLINK_MX6DL
	bool "Support Retronix ADLINK Board (imx6dl SOC)"
	select DM
	select DM_THERMAL
	
config TARGET_RTX_A6PLUS_MX6Q
	bool "Support Retronix A6Plus Board (imx6q SOC)"
	select DM
	select DM_THERMAL

config TARGET_RTX_A6_MX6Q
	bool "Support Retronix A6 Board (imx6q SOC)"
	select DM
	select DM_THERMAL

config TARGET_RTX_PITX_MX6Q
	bool "Support Retronix PITX Board (imx6q SOC)"
	select DM
	select DM_THERMAL

config TARGET_RTX_Q7_MX6Q
	bool "Support Retronix Q7 Board (imx6q SOC)"
	select DM
	select DM_THERMAL

config TARGET_RTX_VOLAR111Plus_MX6DL
	bool "Support Retronix VOLAR111Plus Board (imx6dl SOC)"
	select DM
	select DM_THERMAL

config TARGET_RTX_TREADMILL_MX6Q
	bool "Support Retronix TREADMILL Board (imx6q SOC)"
	select DM
	select DM_THERMAL
```

## board/retronix/configs/rtx_pitx_mx6q_nanya1g_dtb_rtx_all_linux_defconfig
```kconfig
CONFIG_ARM=y
CONFIG_ARCH_MX6=y
CONFIG_TARGET_RTX_PITX_MX6Q=y
CONFIG_SYS_EXTRA_OPTIONS="IMX_CONFIG=board/retronix/rtx_pitx_mx6q/ddr/nanya_ddr3_mx6q_1g.cfg,MX6Q"

CONFIG_SYS_MALLOC_F=y
CONFIG_SYS_MALLOC_F_LEN=0x400
CONFIG_EXTRA_ENV_USE_DTB=y

CONFIG_BOOTARGS_GEN="init=/sbin/init root=${mmcrootpath};if test -n ${mac1_val};then setenv bootargs ${bootargs} fec_mac=${mac1_val};fi;if test -n ${mac2_val};then setenv bootargs ${bootargs} smsc_mac=${mac2_val};fi;"
CONFIG_MMCROOTPATH="/dev/mmcblk0p1 rootwait rw"
CONFIG_BOOTARGS_HDMI="video=mxcfb0:dev=hdmi,1920x1080M@60,if=RGB24,bpp=32 video=mxcfb1:off video=mxcfb2:off fbmem=28M"
CONFIG_BOOTARGS_VGA="video=mxcfb0:dev=ldb,1024x768@60,if=RGB24,bpp=32 video=mxcfb1:dev=ldb,1024x768@60,if=RGB24,bpp=32 video=mxcfb2:off fbmem=18M,18M"
CONFIG_BOOTARGS_DUAL_HDMI="video=mxcfb0:dev=hdmi,1920x1080M@60,if=RGB24,bpp=32 video=mxcfb1:dev=ldb,1024x768@60,if=RGB24,bpp=32 video=mxcfb2:dev=ldb,1024x768@60,if=RGB24,bpp=32 fbmem=28M,18M,18M"
CONFIG_BOOTARGS_GUIMEM="gpumem=176M vmalloc=400M"
CONFIG_GUIPORT="dual-hdmi"

CONFIG_UBOOT_MMCNUM="2"
CONFIG_UPDATEROOT="/dev/mmcblk1p1"

CONFIG_DEF_LOADADDR=0x10800000
CONFIG_DTB_LOADADDR=0x11C00000
CONFIG_RD_LOADADDR=0x11D00000

#CONFIG_BOOTSEL_FUNC_PASSWORD=y
#CONFIG_BOOTSEL_FUNC_CHANG_PW=y
CONFIG_BOOTSEL_FUNC_UD_EXTSD=y
#CONFIG_BOOTSEL_FUNC_UD_USB=y
CONFIG_BOOTSEL_FUNC_MENU=y
CONFIG_BOOTSEL_FUNC_CHG_STORAGE=y
#CONFIG_BOOTSEL_FUNC_SCANFILE_SELF=y
CONFIG_MCU_WATCHDOG_TIME=0x3C
```

## board/retronix/rtx_a6_mx6q/Kconfig
```kconfig
if TARGET_RTX_A6_MX6Q

config SYS_BOARD
	default "rtx_a6_mx6q"

config SYS_VENDOR
	default "retronix"

config SYS_SOC
	default "mx6"

config SYS_CONFIG_NAME
	default "retronix/rtx_a6_mx6q"     if !TARGET_RTX_A6_MX6Q_MFG
	default "retronix/rtx_a6_mx6q_mfg" if TARGET_RTX_A6_MX6Q_MFG

config EXTRA_ENV_USE_DTB
	bool "kernel is dtb type."
	default y
	help
	  Kernel has DTB.

config BOOTARGS_GEN
	string "bootagrs parameter"
	default "init=/sbin/init root=/dev/mmcblk0p1 rootwait rw"
	help
	  GUI port hdmi,vga or dual-hdmi.

config GUIPORT
	string "GUI port"
	default "hdmi"
	help
	  GUI port hdmi,vga or dual-hdmi.

config BOOTARGS_HDMI
	string "hdmi gui parameter"
	default "video=mxcfb0:dev=hdmi,1920x1080M@60,if=RGB24,bpp=32 video=mxcfb1:off video=mxcfb2:off"
	help
	  GUI port hdmi,vga or dual-hdmi.

config BOOTARGS_VGA
	string "vga gui parameter"
	default "video=mxcfb0:dev=ldb,LDB-FUHD,if=RGB24,bpp=32 video=mxcfb1:off video=mxcfb2:of"
	help
	  GUI port hdmi,vga or dual-hdmi.

config BOOTARGS_DUAL_HDMI
	string "dual gui parameter"
	default "video=mxcfb0:dev=ldb,LDB-FUHD,if=RGB24,bpp=32 video=mxcfb1:dev=hdmi,1920x1080M@60,if=RGB24,bpp=32 video=mxcfb2:off"
	help
	  GUI port hdmi,vga or dual-hdmi.

config BOOTARGS_GUIMEM
	string "FB GPU memory"
	default "fbmem=28M,28M gpumem=176M vmalloc=400M"
	help
	  fbmem,gpumem and vmallock define.

config UBOOT_MMCNUM
	string "boot mmc number"
	default "2"
	help
	  uboot mmc num.

config UPDATEROOT
	string "update mount path"
	default "/dev/mmcblk1p1"
	help
	  update and reovery filesystem mount path.

config VGA_VIDEO
	string "vga resolution"
	default "1024x768@60"
	help
	  VGA resolution.

config DEF_LOADADDR
	hex "loadaddr"
	default "0x10800000"
	help
	  loadaddr.

config DTB_LOADADDR
	hex "dtb_loadaddr"
	default "0x11300000"
	help
	  dtb_loadaddr.

config RD_LOADADDR
	hex "rd_loadaddr"
	default "0x11400000"
	help
	  rd_loadaddr.

config SYS_TEXT_BASE
	hex "system text loadaddr address"
	default "0x27800000"
	help
	  SYS_TEXT_BASE.

endif
```

## board/retronix/rtx_a6plus_mx6q/Kconfig
```kconfig
if TARGET_RTX_A6PLUS_MX6Q

config SYS_BOARD
	default "rtx_a6plus_mx6q"

config SYS_VENDOR
	default "retronix"

config SYS_SOC
	default "mx6"

config SYS_CONFIG_NAME
	default "retronix/rtx_a6plus_mx6q"     if !TARGET_RTX_A6PLUS_MX6Q_MFG
	default "retronix/rtx_a6plus_mx6q_mfg" if TARGET_RTX_A6PLUS_MX6Q_MFG

config EXTRA_ENV_USE_DTB
	bool "kernel is dtb type."
	default y
	help
	  Kernel has DTB.

config MMCROOTPATH
	string "rootfs mount path"
	default "root=/dev/mmcblk0p1 rootwait rw"
	help
	  FileSystem mount path.

config BOOTARGS_GEN
	string "bootagrs parameter"
	default "init=/sbin/init ${mmcrootpath}"
	help
	  bootargs parameter.

config DEFAULT_MAC01
	string "mac01 default address"
	default "1E:ED:19:27:1A:B3"
	help
	  MAC address.

config GUIPORT
	string "GUI port"
	default "hdmi"
	help
	  GUI port hdmi,vga or dual-hdmi.

config BOOTARGS_HDMI
	string "hdmi gui parameter"
	default "video=mxcfb0:dev=hdmi,1920x1080M@60,if=RGB24,bpp=32 video=mxcfb1:off video=mxcfb2:off"
	help
	  GUI port hdmi.

config BOOTARGS_VGA
	string "vga gui parameter"
	default "video=mxcfb0:dev=ldb,LDB-FUHD,if=RGB24,bpp=32 video=mxcfb1:off video=mxcfb2:of"
	help
	  GUI port vga.

config BOOTARGS_DUAL_HDMI
	string "dual gui parameter"
	default "video=mxcfb0:dev=ldb,LDB-FUHD,if=RGB24,bpp=32 video=mxcfb1:dev=hdmi,1920x1080M@60,if=RGB24,bpp=32 video=mxcfb2:off"
	help
	  GUI port dual-hdmi.

config BOOTARGS_GUIMEM
	string "FB GPU memory"
	default "fbmem=28M,28M gpumem=176M vmalloc=400M"
	help
	  fbmem,gpumem and vmallock define.

config UBOOT_MMCNUM
	string "boot mmc number"
	default "2"
	help
	  uboot mmc num.

config UPDATEROOT
	string "update mount path"
	default "/dev/mmcblk1p1"
	help
	  update and reovery filesystem mount path.

config VGA_VIDEO
	string "vga resolution"
	default "1024x768@60"
	help
	  VGA resolution.

config DEF_LOADADDR
	hex "loadaddr"
	default "0x10880000"
	help
	  loadaddr.

config DTB_LOADADDR
	hex "dtb_loadaddr"
	default "0x10800000"
	help
	  dtb_loadaddr.

config RD_LOADADDR
	hex "rd_loadaddr"
	default "0x11400000"
	help
	  rd_loadaddr.

config SYS_TEXT_BASE
	hex "system text loadaddr address"
	default "0x27800000"
	help
	  SYS_TEXT_BASE.

endif
```

## board/retronix/rtx_bishop_mx53/Kconfig
```kconfig
if TARGET_RTX_BISHOP_MX53

config SYS_BOARD
	default "rtx_bishop_mx53"

config SYS_VENDOR
	default "retronix"

config SYS_SOC
	default "mx5"

config SYS_CONFIG_NAME
	default "retronix/rtx_bishop_mx53"     if !TARGET_RTX_BISHOP_MX53_MFG
	default "retronix/rtx_bishop_mx53_mfg" if TARGET_RTX_BISHOP_MX53_MFG

endif
```
