## board/retronix/rtx_pitx_mx6q/Kconfig
```kconfig
if TARGET_RTX_PITX_MX6Q

config SYS_BOARD
	default "rtx_pitx_mx6q"

config SYS_VENDOR
	default "retronix"

config SYS_SOC
	default "mx6"

config TARGET_RTX_PITX_MX6Q_MFG
	bool "Uboot is MFG mode."
	default n
	help
	  Uboot is MFG mode.
	  
config SYS_CONFIG_NAME
	default "retronix/rtx_pitx_mx6q"     if !TARGET_RTX_PITX_MX6Q_MFG
	default "retronix/rtx_pitx_mx6q_mfg" if TARGET_RTX_PITX_MX6Q_MFG

config EXTRA_ENV_USE_DTB
	bool "kernel is dtb type."
	default y
	help
	  Kernel has DTB.

config MMCROOTPATH
	string "rootfs mount path"
	default "root=/dev/mmcblk0p1 rootwait rw"
	help
	  FileSystem mount path.

config BOOTARGS_GEN
	string "bootagrs parameter"
	default "init=/sbin/init ${mmcrootpath}"
	help
	  bootargs parameter.

config DEFAULT_MAC01
	string "mac01 default address"
	default "1E:ED:19:27:1A:B3"
	help
	  MAC address.

config GUIPORT
	string "GUI port"
	default "hdmi"
	help
	  GUI port hdmi,vga or dual-hdmi.

config BOOTARGS_HDMI
	string "hdmi gui parameter"
	default "video=mxcfb0:dev=hdmi,1920x1080M@60,if=RGB24,bpp=32 video=mxcfb1:off video=mxcfb2:off"
	help
	  GUI port hdmi.

config BOOTARGS_VGA
	string "vga gui parameter"
	default "video=mxcfb0:dev=ldb,LDB-FUHD,if=RGB24,bpp=32 video=mxcfb1:off video=mxcfb2:of"
	help
	  GUI port vga.

config BOOTARGS_DUAL_HDMI
	string "dual gui parameter"
	default "video=mxcfb0:dev=ldb,LDB-FUHD,if=RGB24,bpp=32 video=mxcfb1:dev=hdmi,1920x1080M@60,if=RGB24,bpp=32 video=mxcfb2:off"
	help
	  GUI port dual-hdmi.

config BOOTARGS_UI_VAR01
	string "project ui port 01"
	default "\0"
	help
	  GUI port by project.

config BOOTARGS_UI_VAR02
	string "project ui port 02"
	default "\0"
	help
	  GUI port by project.

config BOOTARGS_UI_VAR03
	string "project ui port 03"
	default "\0"
	help
	  GUI port by project.

config BOOTARGS_UI_VAR04
	string "project ui port 04"
	default "\0"
	help
	  GUI port by project.

config BOOTARGS_UI_VAR05
	string "project ui port 05"
	default "\0"
	help
	  GUI port by project.

config BOOTARGS_GUIMEM
	string "FB GPU memory"
	default "fbmem=28M,28M gpumem=176M vmalloc=400M"
	help
	  fbmem,gpumem and vmallock define.

config UBOOT_MMCNUM
	string "boot mmc number"
	default "2"
	help
	  uboot mmc num.

config UPDATEROOT
	string "update mount path"
	default "/dev/mmcblk1p1"
	help
	  update and reovery filesystem mount path.

config VGA_VIDEO
	string "vga or hdmi resolution. This is define def_video parameter."
	default "1024x768@60"
	help
	  VGA resolution.

config DEF_LOADADDR
	hex "loadaddr"
	default "0x10800000"
	help
	  loadaddr.

config DTB_LOADADDR
	hex "dtb_loadaddr"
	default "0x11C00000"
	help
	  dtb_loadaddr.

config RD_LOADADDR
	hex "rd_loadaddr"
	default "0x11D00000"
	help
	  rd_loadaddr.

config SYS_TEXT_BASE
	hex "system text loadaddr address"
	default "0x27800000"
	help
	  SYS_TEXT_BASE.

config BOOTSEL_FUNC_PASSWORD
	bool "Bootsel password function."
	default n
	help
	  Uboot passwork funciton.

config BOOTSEL_FUNC_CHANG_PW
	bool "Bootsel change password function."
	default n
	help
	  Uboot change passwork funciton.

config BOOTSEL_FUNC_UD_EXTSD
	bool "Bootsel scan extsd function."
	default n
	help
	  Uboot scan external sd card magic code funciton.

config BOOTSEL_FUNC_UD_USB
	bool "Bootsel scan usb function."
	default n
	help
	  Uboot scan usb storage magic code funciton.

config BOOTSEL_FUNC_MENU
	bool "Bootsel menu function."
	default n
	help
	  Uboot munu funciton.It is u/U, r/R, a/A and p/P mode.
	  u/U mode : roption is update.
	  r/R mode : roption is recovery.
	  a/A mode : this is android recovery mode.
	  p/P mode : this is change password mode.

config BOOTSEL_FUNC_CHG_STORAGE
	bool "Bootsel autodetect storage function."
	default n
	help
	  Uboot autodetect upstart device number funciton.
	  usdhc1 is unknow.
	  usdhc2 is mmcblk2
	  usdhc3 is mmcblk1
	  usdhc4 is mmcblk0

config BOOTSEL_FUNC_SCANFILE_SELF
	bool "Bootsel scan self function."
	default n
	help
	  Uboot scan self magic code funciton.

config SILENT_CONSOLE
	bool "message silent."
	default n
	help
	  message silent.

config MCU_WATCHDOG_TIME
	hex "uboot to os start-up time."
	default "0"
	help
	  uboot to os start-up time.disable if set is 0.

endif
```

## configs/imx6qsabresdandroid_defconfig
```kconfig
CONFIG_ARM=y
CONFIG_ARCH_MX6=y
CONFIG_TARGET_MX6QSABRESD=y
CONFIG_VIDEO=y
CONFIG_SYS_EXTRA_OPTIONS="IMX_CONFIG=board/freescale/mx6sabresd/micron_ddr3_mx6q_2g.cfg,ANDROID_SUPPORT"
CONFIG_EFI_PARTITION=y
CONFIG_BOOTDELAY=0
# CONFIG_CONSOLE_MUX is not set
CONFIG_SYS_CONSOLE_IS_IN_ENV=y
CONFIG_SYS_CONSOLE_OVERWRITE_ROUTINE=y
CONFIG_HUSH_PARSER=y
CONFIG_CMD_BOOTZ=y
# CONFIG_CMD_IMLS is not set
# CONFIG_CMD_FLASH is not set
CONFIG_CMD_MEMTEST=y
CONFIG_CMD_MMC=y
CONFIG_CMD_SF=y
CONFIG_CMD_I2C=y
CONFIG_CMD_USB=y
CONFIG_CMD_GPIO=y
CONFIG_CMD_DHCP=y
CONFIG_CMD_MII=y
CONFIG_CMD_PING=y
CONFIG_CMD_CACHE=y
CONFIG_CMD_EXT2=y
CONFIG_CMD_EXT4=y
CONFIG_CMD_EXT4_WRITE=y
CONFIG_CMD_FAT=y
CONFIG_CMD_FS_GENERIC=y
CONFIG_USB=y
CONFIG_USB_STORAGE=y
# CONFIG_VIDEO_SW_CURSOR is not set
# CONFIG_OF_LIBFDT=y

CONFIG_DEFAULT_DEVICE_TREE="imx6q-sabresd"
CONFIG_OF_CONTROL=y
CONFIG_DM_GPIO=y
CONFIG_DM_MMC=y
CONFIG_PINCTRL=y
CONFIG_PINCTRL_IMX6=y
CONFIG_DM_REGULATOR=y
CONFIG_DM_REGULATOR_PFUZE100=y
CONFIG_DM_REGULATOR_FIXED=y
CONFIG_DM_REGULATOR_GPIO=y
CONFIG_DM_ETH=y
CONFIG_DM_USB=y

CONFIG_ENV_IS_IN_MMC=y

CONFIG_NOT_UUU_BUILD=y

CONFIG_BOOTARGS_HDMI="video=mxcfb0:dev=hdmi,${def_video},if=RGB24,bpp=32 video=mxcfb1:off video=mxcfb2:off video=mxcfb3:off vmalloc=128M"
CONFIG_GUIPORT="hdmi"
CONFIG_UPDATEROOT="/dev/mmcblk1p1"
CONFIG_VGA_VIDEO="800x480M@60"
CONFIG_DEF_LOADADDR=0x10800000
CONFIG_DTB_LOADADDR=0x11C00000
CONFIG_RD_LOADADDR=0x11D00000
#CONFIG_BOOTSEL_FUNC_PASSWORD=y
#CONFIG_BOOTSEL_FUNC_CHANG_PW=y
CONFIG_BOOTSEL_FUNC_UD_EXTSD=y
#CONFIG_BOOTSEL_FUNC_UD_USB=y
CONFIG_BOOTSEL_FUNC_MENU=y
CONFIG_BOOTSEL_FUNC_CHG_STORAGE=y
#CONFIG_BOOTSEL_FUNC_SCANFILE_SELF=y
CONFIG_BOOTSEL_FUNC_USBSTART=y
CONFIG_MCU_WATCHDOG_TIME=0
```

## configs/rtx_a6_mx6q_android_defconfig
```kconfig
CONFIG_SYS_EXTRA_OPTIONS="IMX_CONFIG=board/retronix/rtx_a6_mx6q/micron_ddr3_mx6q_1g.cfg,MX6Q,ANDROID_SUPPORT"
CONFIG_ARM=y
CONFIG_TARGET_RTX_A6_MX6Q=y
CONFIG_SYS_MALLOC_F=y
CONFIG_SYS_MALLOC_F_LEN=0x400
CONFIG_DM=y
CONFIG_DM_THERMAL=y
```

## configs/rtx_a6_mx6q_defconfig
```kconfig
CONFIG_SYS_EXTRA_OPTIONS="IMX_CONFIG=board/retronix/rtx_a6_mx6q/micron_ddr3_mx6q_1g.cfg,MX6Q"
CONFIG_ARM=y
CONFIG_TARGET_RTX_A6_MX6Q=y
CONFIG_DM=y
CONFIG_DM_THERMAL=y
```
