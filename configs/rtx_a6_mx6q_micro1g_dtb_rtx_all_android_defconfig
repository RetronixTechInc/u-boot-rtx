## configs/rtx_a6_mx6q_micro1g_dtb_rtx_all_android_defconfig
```kconfig
CONFIG_SYS_EXTRA_OPTIONS="IMX_CONFIG=board/retronix/rtx_a6_mx6q/micron_ddr3_mx6q_1g.cfg,MX6Q,ANDROID_SUPPORT"
CONFIG_ARM=y
CONFIG_TARGET_RTX_A6_MX6Q=y
CONFIG_SYS_MALLOC_F=y
CONFIG_SYS_MALLOC_F_LEN=0x400
CONFIG_DM=y
CONFIG_DM_THERMAL=y
CONFIG_EXTRA_ENV_USE_DTB=y
CONFIG_BOOTARGS_GEN="fec_mac=${fecmac_val} init=/init"
CONFIG_BOOTARGS_HDMI="video=mxcfb0:dev=hdmi,1920x1080M@60,if=RGB24,bpp=32 video=mxcfb1:off video=mxcfb2:off"
CONFIG_BOOTARGS_VGA="video=mxcfb0:dev=lcd,${def_video},if=RGB24,bpp=32 video=mxcfb1:off video=mxcfb2:off"
CONFIG_BOOTARGS_DUAL_HDMI="video=mxcfb1:dev=lcd,${def_video},if=RGB24,bpp=32 video=mxcfb0:dev=hdmi,1920x1080M@60,if=RGB24,bpp=32 video=mxcfb2:off"
CONFIG_BOOTARGS_GUIMEM="fbmem=28M,28M gpumem=176M vmalloc=400M ldb=spl0"
CONFIG_GUIPORT="hdmi"
CONFIG_UBOOT_MMCNUM="2"
CONFIG_UPDATEROOT="/dev/mmcblk1p1"
CONFIG_VGA_VIDEO="1024x768@60"
```

## configs/rtx_a6_mx6q_micro1g_dtb_rtx_all_linux_defconfig
```kconfig
CONFIG_SYS_EXTRA_OPTIONS="IMX_CONFIG=board/retronix/rtx_a6_mx6q/micron_ddr3_mx6q_1g.cfg,MX6Q"
CONFIG_ARM=y
CONFIG_TARGET_RTX_A6_MX6Q=y
CONFIG_SYS_MALLOC_F=y
CONFIG_SYS_MALLOC_F_LEN=0x400
CONFIG_DM=y
CONFIG_DM_THERMAL=y
CONFIG_EXTRA_ENV_USE_DTB=y
CONFIG_BOOTARGS_GEN="fec_mac=${mac1_val} init=/sbin/init root=${mmcrootpath}"
CONFIG_MMCROOTPATH="/dev/mmcblk0p1 rootwait rw"
CONFIG_BOOTARGS_HDMI="video=mxcfb0:dev=hdmi,1920x1080M@60,if=RGB24,bpp=32 video=mxcfb1:off video=mxcfb2:off"
CONFIG_BOOTARGS_VGA="video=mxcfb0:dev=lcd,${def_video},if=RGB24,bpp=32 video=mxcfb1:off video=mxcfb2:off"
CONFIG_BOOTARGS_DUAL_HDMI="video=mxcfb0:dev=lcd,${def_video},if=RGB24,bpp=32 video=mxcfb1:dev=hdmi,1920x1080M@60,if=RGB24,bpp=32 video=mxcfb2:off"
CONFIG_BOOTARGS_GUIMEM="fbmem=28M,28M gpumem=176M vmalloc=400M ldb=spl0"
CONFIG_GUIPORT="hdmi"
CONFIG_UBOOT_MMCNUM="2"
CONFIG_UPDATEROOT="/dev/mmcblk1p1"
CONFIG_VGA_VIDEO="1024x768@60"
#CONFIG_BOOTSEL_FUNC_PASSWORD=y
#CONFIG_BOOTSEL_FUNC_CHANG_PW=y
CONFIG_BOOTSEL_FUNC_UD_EXTSD=y
#CONFIG_BOOTSEL_FUNC_UD_USB=y
CONFIG_BOOTSEL_FUNC_MENU=y
CONFIG_BOOTSEL_FUNC_CHG_STORAGE=y
#CONFIG_BOOTSEL_FUNC_SCANFILE_SELF=y
```

## configs/rtx_a6_mx6q_micro1g_null_roymark_box_android_defconfig
```kconfig
CONFIG_SYS_EXTRA_OPTIONS="IMX_CONFIG=board/retronix/rtx_a6_mx6q/micron_ddr3_mx6q_1g.cfg,MX6Q,ANDROID_SUPPORT"
CONFIG_ARM=y
CONFIG_TARGET_RTX_A6_MX6Q=y
CONFIG_SYS_MALLOC_F=y
CONFIG_SYS_MALLOC_F_LEN=0x400
CONFIG_DM=y
CONFIG_DM_THERMAL=y
CONFIG_EXTRA_ENV_USE_DTB=n
CONFIG_BOOTARGS_GEN="init=/init;if test -n ${mac1_val};then setenv bootargs ${bootargs} fec_mac=${mac1_val};fi;"
CONFIG_BOOTARGS_HDMI="video=mxcfb0:dev=hdmi,1920x1080M@60,if=RGB24,bpp=32 video=mxcfb1:off video=mxcfb2:off"
CONFIG_BOOTARGS_VGA="video=mxcfb0:dev=lcd,${def_video},if=RGB24,bpp=32 video=mxcfb1:off video=mxcfb2:off"
CONFIG_BOOTARGS_DUAL_HDMI="video=mxcfb0:dev=hdmi,1920x1080M@60,if=RGB24,bpp=32 video=mxcfb1:dev=lcd,${def_video},if=RGB24,bpp=32 video=mxcfb2:off"
CONFIG_BOOTARGS_GUIMEM="fbmem=28M,28M gpumem=176M vmalloc=400M ldb=dul0"
CONFIG_GUIPORT="dual-hdmi"
CONFIG_UBOOT_MMCNUM="2"
CONFIG_UPDATEROOT="/dev/mmcblk1p1"
CONFIG_VGA_VIDEO="1024x768@60"
CONFIG_BOOTSEL_FUNC_PASSWORD=y
#CONFIG_BOOTSEL_FUNC_CHANG_PW=y
CONFIG_BOOTSEL_FUNC_UD_EXTSD=y
#CONFIG_BOOTSEL_FUNC_UD_USB=y
CONFIG_BOOTSEL_FUNC_MENU=y
CONFIG_BOOTSEL_FUNC_CHG_STORAGE=y
#CONFIG_BOOTSEL_FUNC_SCANFILE_SELF=y
CONFIG_SILENT_CONSOLE=y
CONFIG_MCU_WATCHDOG_TIME=0x78
CONFIG_EXTRA_ENV_BOOTCMD_GEN="run storage r_kernel r_ramdisk; bootm ${loadaddr} ${rd_loadaddr}"
```

## configs/rtx_a6_mx6q_micro1g_y_rtx_all_linux_defconfig
```kconfig
CONFIG_SYS_EXTRA_OPTIONS="IMX_CONFIG=board/retronix/rtx_a6_mx6q/micron_ddr3_mx6q_1g.cfg,MX6Q"
CONFIG_ARM=y
CONFIG_TARGET_RTX_A6_MX6Q=y
CONFIG_SYS_MALLOC_F=y
CONFIG_SYS_MALLOC_F_LEN=0x400
CONFIG_DM=y
CONFIG_DM_THERMAL=y
CONFIG_EXTRA_ENV_USE_DTB=y
CONFIG_BOOTARGS_GEN="init=/sbin/init root=/dev/mmcblk0p1 rootwait rw"
CONFIG_BOOTARGS_HDMI="video=mxcfb0:dev=hdmi,1920x1080M@60,if=RGB24,bpp=32 video=mxcfb1:off video=mxcfb2:off"
CONFIG_BOOTARGS_VGA="video=mxcfb0:dev=lcd,1024x768@60,if=RGB24,bpp=32 video=mxcfb1:off video=mxcfb2:off"
CONFIG_BOOTARGS_DUAL_HDMI="video=mxcfb0:dev=lcd,1024x768@60,if=RGB24,bpp=32 video=mxcfb1:dev=hdmi,1920x1080M@60,if=RGB24,bpp=32 video=mxcfb2:off"
CONFIG_BOOTARGS_GUIMEM="fbmem=28M,28M gpumem=176M vmalloc=400M ldb=spl0"
CONFIG_GUIPORT="hdmi"
CONFIG_UBOOT_MMCNUM="2"
CONFIG_UPDATEROOT="/dev/mmcblk1p1"
```

## configs/rtx_a6plus_mx6q_defconfig
```kconfig
CONFIG_SYS_EXTRA_OPTIONS="IMX_CONFIG=board/retronix/rtx_a6plus_mx6q/micron_ddr3_mx6q_1g.cfg,MX6Q"
CONFIG_ARM=y
CONFIG_TARGET_RTX_A6PLUS_MX6Q=y
CONFIG_SYS_MALLOC_F=y
CONFIG_SYS_MALLOC_F_LEN=0x400
CONFIG_DM=y
CONFIG_DM_THERMAL=y
```

## configs/rtx_a6plus_mx6q_micro1g_null_roymark_tv_android_defconfig
```kconfig
CONFIG_SYS_EXTRA_OPTIONS="IMX_CONFIG=board/retronix/rtx_a6plus_mx6q/micron_ddr3_mx6q_1g.cfg,MX6Q,ANDROID_SUPPORT"
CONFIG_ARM=y
CONFIG_TARGET_RTX_A6PLUS_MX6Q=y
CONFIG_SYS_MALLOC_F=y
CONFIG_SYS_MALLOC_F_LEN=0x400
CONFIG_DM=y
CONFIG_DM_THERMAL=y
CONFIG_EXTRA_ENV_USE_DTB=n
CONFIG_BOOTARGS_GEN="fec_mac=${mac1_val} init=/init"
CONFIG_BOOTARGS_HDMI="video=mxcfb0:dev=hdmi,1920x1080M@60,if=RGB24,bpp=32 video=mxcfb1:off video=mxcfb2:off"
CONFIG_BOOTARGS_VGA="video=mxcfb0:dev=ldb,LDB-FUHD,if=RGB24,bpp=32 video=mxcfb1:off video=mxcfb2:off"
CONFIG_BOOTARGS_DUAL_HDMI="video=mxcfb0:dev=ldb,LDB-FUHD,if=RGB24,bpp=32 video=mxcfb1:dev=hdmi,1920x1080M@60,if=RGB24,bpp=32 video=mxcfb2:off"
CONFIG_BOOTARGS_GUIMEM="fbmem=28M,28M gpumem=176M vmalloc=400M ldb=spl0"
CONFIG_GUIPORT="dual-hdmi"
CONFIG_UBOOT_MMCNUM="2"
CONFIG_UPDATEROOT="/dev/mmcblk1p1"
CONFIG_DEF_LOADADDR=0x10880000
CONFIG_DTB_LOADADDR=0x10800000
CONFIG_RD_LOADADDR=0x11400000
CONFIG_SYS_TEXT_BASE=0x27800000
#CONFIG_BOOTSEL_FUNC_PASSWORD=y
#CONFIG_BOOTSEL_FUNC_CHANG_PW=y
CONFIG_BOOTSEL_FUNC_UD_EXTSD=y
#CONFIG_BOOTSEL_FUNC_UD_USB=y
CONFIG_BOOTSEL_FUNC_MENU=y
CONFIG_BOOTSEL_FUNC_CHG_STORAGE=y
#CONFIG_BOOTSEL_FUNC_SCANFILE_SELF=y
```

## configs/rtx_adlink_mx6dl_micro1g_dtb_rtx_all_linux_defconfig
```kconfig
CONFIG_SYS_EXTRA_OPTIONS="IMX_CONFIG=board/retronix/rtx_adlink_mx6dl/micro_ddr3_mx6dl_1g.cfg,MX6DL"
CONFIG_ARM=y
CONFIG_TARGET_RTX_ADLINK_MX6DL=y
CONFIG_SYS_MALLOC_F=y
CONFIG_SYS_MALLOC_F_LEN=0x400
CONFIG_DM=y
CONFIG_DM_THERMAL=y
CONFIG_EXTRA_ENV_USE_DTB=y
CONFIG_BOOTARGS_GEN="init=/sbin/init root=${mmcrootpath};if test -n ${mac1_val};then setenv bootargs ${bootargs} fec_mac=${mac1_val};fi;if test -n ${mac2_val};then setenv bootargs ${bootargs} smsc_mac=${mac2_val};fi;"
CONFIG_MMCROOTPATH="/dev/mmcblk0p1 rootwait rw"
CONFIG_BOOTARGS_HDMI="video=mxcfb2:dev=hdmi,1920x1080M@60,if=RGB24,bpp=32"
CONFIG_BOOTARGS_VGA="video=mxcfb0:dev=ldb,LDB-FUHD,if=RGB24,bpp=32 video=mxcfb1:off video=mxcfb2:off"
CONFIG_BOOTARGS_DUAL_HDMI="video=mxcfb0:dev=ldb,LDB-FUHD,if=RGB24,bpp=32 video=mxcfb1:dev=hdmi,1920x1080M@60,if=RGB24,bpp=32 video=mxcfb2:off"
CONFIG_BOOTARGS_GUIMEM="fbmem=28M,28M gpumem=176M vmalloc=400M ldb=spl0"
CONFIG_GUIPORT="hdmi"
CONFIG_UBOOT_MMCNUM="2"
CONFIG_UPDATEROOT="/dev/mmcblk1p1"
#CONFIG_BOOTSEL_FUNC_PASSWORD=y
#CONFIG_BOOTSEL_FUNC_CHANG_PW=y
CONFIG_BOOTSEL_FUNC_UD_EXTSD=y
#CONFIG_BOOTSEL_FUNC_UD_USB=y
CONFIG_BOOTSEL_FUNC_MENU=y
CONFIG_BOOTSEL_FUNC_CHG_STORAGE=y
#CONFIG_BOOTSEL_FUNC_SCANFILE_SELF=y
```

## configs/rtx_bishop_mx53_mfg_defconfig
```kconfig
CONFIG_SYS_EXTRA_OPTIONS="IMX_CONFIG=board/retronix/rtx_bishop_mx53/imximage.cfg"
CONFIG_ARM=y
CONFIG_TARGET_RTX_BISHOP_MX53=y
CONFIG_TARGET_RTX_BISHOP_MX53_MFG=y
```

## configs/rtx_pitxP_mx6q_nanya1g_dtb_rtx_all_linux_defconfig
```kconfig
CONFIG_ARM=y
CONFIG_ARCH_MX6=y
CONFIG_TARGET_RTX_PITXP_MX6Q=y
CONFIG_NR_DRAM_BANKS=1
CONFIG_ENV_SIZE=0x2000
CONFIG_ENV_OFFSET=0xC00000
CONFIG_DM_VIDEO=y
# CONFIG_VIDEO_BPP8 is not set
# CONFIG_VIDEO_BPP32 is not set
CONFIG_SYS_WHITE_ON_BLACK=y
CONFIG_VIDEO_IPUV3=y
CONFIG_SYS_EXTRA_OPTIONS="IMX_CONFIG=board/retronix/rtx_pitxP_mx6q/nanya_ddr3_mx6q_1g.cfg,MX6Q"
CONFIG_IMX_OPTEE=y
CONFIG_ENV_IS_IN_MMC=y
CONFIG_BOOTDELAY=3
# CONFIG_CONSOLE_MUX is not set
CONFIG_SYS_CONSOLE_IS_IN_ENV=y
CONFIG_SYS_CONSOLE_OVERWRITE_ROUTINE=y
CONFIG_SUPPORT_RAW_INITRD=y
CONFIG_BOUNCE_BUFFER=y
CONFIG_HUSH_PARSER=y
CONFIG_CMD_BOOTZ=y
# CONFIG_CMD_IMLS is not set
# CONFIG_CMD_FLASH is not set
CONFIG_CMD_MEMTEST=y
CONFIG_CMD_MMC=y
CONFIG_CMD_PART=y
CONFIG_CMD_PCI=y
CONFIG_CMD_SF=y
CONFIG_CMD_I2C=y
CONFIG_CMD_USB_MASS_STORAGE=y
CONFIG_CMD_GPIO=y
CONFIG_CMD_DHCP=y
CONFIG_CMD_MII=y
CONFIG_CMD_PING=y
CONFIG_CMD_CACHE=y
CONFIG_CMD_EXT2=y
CONFIG_CMD_EXT4=y
CONFIG_CMD_EXT4_WRITE=y
CONFIG_CMD_FAT=y
CONFIG_CMD_FS_GENERIC=y
CONFIG_DM_SPI_FLASH=y
CONFIG_SPI_FLASH=y
CONFIG_SF_DEFAULT_BUS=0
CONFIG_SF_DEFAULT_MODE=0
CONFIG_SF_DEFAULT_SPEED=20000000
CONFIG_SF_DEFAULT_CS=0
CONFIG_SPI_FLASH_STMICRO=y
CONFIG_SPI=y
CONFIG_DM_SPI=y
CONFIG_MXC_SPI=y
CONFIG_USB=y
CONFIG_DM_USB=y
CONFIG_USB_GADGET=y
CONFIG_USB_GADGET_DOWNLOAD=y
CONFIG_USB_GADGET_MANUFACTURER="FSL"
CONFIG_USB_GADGET_VENDOR_NUM=0x0525
CONFIG_USB_GADGET_PRODUCT_NUM=0xa4a5
CONFIG_CI_UDC=y
# CONFIG_VIDEO_SW_CURSOR is not set
# CONFIG_OF_LIBFDT=y

CONFIG_DEFAULT_DEVICE_TREE="rtx-imx6q-pitx-b21"
CONFIG_OF_CONTROL=y
CONFIG_DM_GPIO=y
CONFIG_FSL_USDHC=y
CONFIG_PINCTRL=y
CONFIG_PINCTRL_IMX6=y
CONFIG_DM_REGULATOR=y
CONFIG_DM_REGULATOR_PFUZE100=y
CONFIG_DM_REGULATOR_FIXED=y
CONFIG_DM_REGULATOR_GPIO=y
CONFIG_DM_ETH=y
CONFIG_PHYLIB=y
CONFIG_MII=y
CONFIG_PCI=y
CONFIG_DM_PCI=y
CONFIG_REGMAP=y
CONFIG_SYSCON=y

CONFIG_CMD_FASTBOOT=y
CONFIG_USB_FUNCTION_FASTBOOT=y
CONFIG_FASTBOOT_UUU_SUPPORT=y
CONFIG_FASTBOOT=y
CONFIG_FASTBOOT_BUF_ADDR=0x12C00000
CONFIG_FASTBOOT_BUF_SIZE=0x40000000
CONFIG_FASTBOOT_FLASH=y
CONFIG_EFI_PARTITION=y

CONFIG_EXTRA_ENV_USE_DTB=y
CONFIG_EXTRA_ENV_BOOTCMD_GEN="run loadimage; bootm ${loadaddr} - ${dtb_loadaddr}"
CONFIG_BOOTARGS_GEN="${startinit} ${mmcrootpath};if test -n ${mac2_val};then setenv bootargs ${bootargs} smsc_mac=${mac2_val};fi;"
CONFIG_MMCROOTPATH="root=/dev/mmcblk0p1 rootwait rw"
CONFIG_BOOTARGS_HDMI="video=mxcfb0:dev=hdmi,${def_video},if=RGB24,bpp=32 video=mxcfb1:off video=mxcfb2:off fbmem=28M hpddis"
CONFIG_BOOTARGS_VGA="video=mxcfb0:dev=ldb,1024x768@60,if=RGB24,bpp=32 video=mxcfb1:dev=ldb,1024x768@60,if=RGB24,bpp=32 video=mxcfb2:off fbmem=18M,18M"
CONFIG_BOOTARGS_DUAL_HDMI="video=mxcfb0:dev=hdmi,${def_video},if=RGB24,bpp=32 video=mxcfb1:dev=ldb,1024x768@60,if=RGB24,bpp=32 video=mxcfb2:dev=ldb,1024x768@60,if=RGB24,bpp=32 fbmem=28M,18M,18M"
CONFIG_BOOTARGS_GUIMEM="gpumem=176M vmalloc=400M"
CONFIG_GUIPORT="hdmi"
CONFIG_UBOOT_MMCNUM="2"
CONFIG_UPDATEROOT="/dev/mmcblk1p1"
CONFIG_VGA_VIDEO="1920x1080@60"
CONFIG_DEF_LOADADDR=0x10800000
CONFIG_DTB_LOADADDR=0x11C00000
CONFIG_RD_LOADADDR=0x11D00000
#CONFIG_BOOTSEL_FUNC_PASSWORD=y
#CONFIG_BOOTSEL_FUNC_CHANG_PW=y
CONFIG_BOOTSEL_FUNC_UD_EXTSD=y
#CONFIG_BOOTSEL_FUNC_UD_USB=y
CONFIG_BOOTSEL_FUNC_MENU=y
CONFIG_BOOTSEL_FUNC_CHG_STORAGE=y
#CONFIG_BOOTSEL_FUNC_SCANFILE_SELF=y
CONFIG_BOOTSEL_FUNC_USBSTART=y
CONFIG_MCU_WATCHDOG_TIME=0
```

## configs/rtx_pitx_mx6q_1g_defconfig
```kconfig
CONFIG_SYS_EXTRA_OPTIONS="IMX_CONFIG=board/retronix/rtx_pitx_mx6q/nanya_ddr3_mx6q_1g.cfg,MX6Q"
CONFIG_ARM=y
CONFIG_TARGET_RTX_PITX_MX6Q=y
CONFIG_SYS_MALLOC_F=y
CONFIG_SYS_MALLOC_F_LEN=0x400
CONFIG_DM=y
CONFIG_DM_THERMAL=y
```

## configs/rtx_pitx_mx6q_nanya2g_dtb_rtx_all_linux_defconfig
```kconfig
CONFIG_SYS_EXTRA_OPTIONS="IMX_CONFIG=board/retronix/rtx_pitx_mx6q/nanya_ddr3_mx6q_2g.cfg,MX6Q,MX6_DDR_2G"
CONFIG_ARM=y
CONFIG_TARGET_RTX_PITX_MX6Q=y
CONFIG_SYS_MALLOC_F=y
CONFIG_SYS_MALLOC_F_LEN=0x400
CONFIG_DM=y
CONFIG_DM_THERMAL=y
CONFIG_EXTRA_ENV_USE_DTB=y
CONFIG_BOOTARGS_GEN="init=/sbin/init root=${mmcrootpath};if test -n ${mac1_val};then setenv bootargs ${bootargs} fec_mac=${mac1_val};fi;if test -n ${mac2_val};then setenv bootargs ${bootargs} smsc_mac=${mac2_val};fi;"
CONFIG_MMCROOTPATH="/dev/mmcblk0p1 rootwait rw"
CONFIG_BOOTARGS_HDMI="video=mxcfb0:dev=hdmi,1920x1080M@60,if=RGB24,bpp=32 video=mxcfb1:off video=mxcfb2:off fbmem=28M"
CONFIG_BOOTARGS_VGA="video=mxcfb0:dev=ldb,1024x768@60,if=RGB24,bpp=32 video=mxcfb1:dev=ldb,1024x768@60,if=RGB24,bpp=32 video=mxcfb2:off fbmem=18M,18M"
CONFIG_BOOTARGS_DUAL_HDMI="video=mxcfb0:dev=hdmi,1920x1080M@60,if=RGB24,bpp=32 video=mxcfb1:dev=ldb,1024x768@60,if=RGB24,bpp=32 video=mxcfb2:dev=ldb,1024x768@60,if=RGB24,bpp=32 fbmem=28M,18M,18M"
CONFIG_BOOTARGS_GUIMEM="gpumem=176M vmalloc=400M"
CONFIG_GUIPORT="dual-hdmi"
CONFIG_UBOOT_MMCNUM="2"
CONFIG_UPDATEROOT="/dev/mmcblk1p1"
#CONFIG_BOOTSEL_FUNC_PASSWORD=y
#CONFIG_BOOTSEL_FUNC_CHANG_PW=y
CONFIG_BOOTSEL_FUNC_UD_EXTSD=y
#CONFIG_BOOTSEL_FUNC_UD_USB=y
CONFIG_BOOTSEL_FUNC_MENU=y
CONFIG_BOOTSEL_FUNC_CHG_STORAGE=y
#CONFIG_BOOTSEL_FUNC_SCANFILE_SELF=y
CONFIG_MCU_WATCHDOG_TIME=0
```

## configs/rtx_q7_mx6q_defconfig
```kconfig
CONFIG_SYS_EXTRA_OPTIONS="IMX_CONFIG=board/retronix/rtx_q7_mx6q/issi_ddr3_mx6q_1g.cfg,MX6Q"
CONFIG_ARM=y
CONFIG_TARGET_RTX_Q7_MX6Q=y
CONFIG_DM=y
CONFIG_DM_THERMAL=y
```

## configs/rtx_treadmill_mx6q_samsung2g_dtb_rtx_all_android_defconfig
```kconfig
CONFIG_SYS_EXTRA_OPTIONS="IMX_CONFIG=board/retronix/rtx-treadmill-mx6q/samsung_mx6q_2g.cfg,MX6Q,ANDROID_SUPPORT,MX6_DDR_2G"
CONFIG_ARM=y
CONFIG_TARGET_RTX_TREADMILL_MX6Q=y
CONFIG_SYS_MALLOC_F=y
CONFIG_SYS_MALLOC_F_LEN=0x400
CONFIG_DM=y
CONFIG_DM_THERMAL=y
CONFIG_EXTRA_ENV_USE_DTB=y
CONFIG_BOOTARGS_GEN="androidboot.selinux=disabled androidboot.dm_verity=disabled init=/init;if test -n ${mac1_val};then setenv bootargs ${bootargs} fec_mac=${mac1_val};fi;"
CONFIG_BOOTARGS_HDMI="video=mxcfb0:dev=hdmi,1920x1080M@60,if=RGB24,bpp=32 video=mxcfb1:off video=mxcfb2:off"
CONFIG_BOOTARGS_VGA="video=mxcfb0:dev=ldb,${def_video},if=RGB24,bpp=32 video=mxcfb1:off video=mxcfb2:off"
CONFIG_BOOTARGS_DUAL_HDMI="video=mxcfb0:dev=hdmi,1920x1080M@60,if=RGB24,bpp=32 video=mxcfb1:dev=lcd,${def_video},if=RGB24,bpp=32 video=mxcfb2:off"
CONFIG_BOOTARGS_GUIMEM="fbmem=28M,28M gpumem=176M vmalloc=400M ldb=spl0"
CONFIG_GUIPORT="vga"
CONFIG_UBOOT_MMCNUM="2"
CONFIG_UPDATEROOT="/dev/mmcblk1p1"
CONFIG_VGA_VIDEO="LDB-FUHD"
#CONFIG_BOOTSEL_FUNC_PASSWORD=y
#CONFIG_BOOTSEL_FUNC_CHANG_PW=y
CONFIG_BOOTSEL_FUNC_UD_EXTSD=y
#CONFIG_BOOTSEL_FUNC_UD_USB=y
CONFIG_BOOTSEL_FUNC_MENU=y
CONFIG_BOOTSEL_FUNC_CHG_STORAGE=y
#CONFIG_BOOTSEL_FUNC_SCANFILE_SELF=y
```

## configs/rtx_volar111plus_mx6dl_samsung1g_dtb_rtx_all_linux_defconfig
```kconfig
CONFIG_SYS_EXTRA_OPTIONS="IMX_CONFIG=board/retronix/rtx-valor111-plus-mx6dl/samsung_mx6dl_1g.cfg,MX6DL"
CONFIG_ARM=y
CONFIG_TARGET_RTX_VOLAR111Plus_MX6DL=y
#CONFIG_TARGET_RTX_VOLAR111Plus_MX6DL_MFG=y
CONFIG_SYS_MALLOC_F=y
CONFIG_SYS_MALLOC_F_LEN=0x400
CONFIG_DM=y
CONFIG_DM_THERMAL=y
CONFIG_EXTRA_ENV_USE_DTB=y
CONFIG_BOOTARGS_GEN="init=/sbin/init ${mmcrootpath};if test -n ${mac1_val};then setenv bootargs ${bootargs} fec_mac=${mac1_val};fi;"
CONFIG_BOOTARGS_HDMI="video=mxcfb0:dev=hdmi,1920x1080M@60,if=RGB24,bpp=32 video=mxcfb1:off video=mxcfb2:off"
CONFIG_BOOTARGS_VGA="video=mxcfb0:dev=lcd,${def_video},if=RGB24,bpp=32 video=mxcfb1:off video=mxcfb2:off"
CONFIG_BOOTARGS_DUAL_HDMI="video=mxcfb1:dev=lcd,${def_video},if=RGB24,bpp=32 video=mxcfb0:dev=hdmi,1920x1080M@60,if=RGB24,bpp=32 video=mxcfb2:off"
CONFIG_BOOTARGS_GUIMEM="fbmem=28M,28M gpumem=176M vmalloc=400M ldb=spl0"
CONFIG_GUIPORT="vga"
CONFIG_UBOOT_MMCNUM="2"
CONFIG_UPDATEROOT="/dev/mmcblk1p1"
CONFIG_VGA_VIDEO="CLAA-WVGA"
#CONFIG_BOOTSEL_FUNC_PASSWORD=y
#CONFIG_BOOTSEL_FUNC_CHANG_PW=y
CONFIG_BOOTSEL_FUNC_UD_EXTSD=y
#CONFIG_BOOTSEL_FUNC_UD_USB=y
CONFIG_BOOTSEL_FUNC_MENU=y
CONFIG_BOOTSEL_FUNC_CHG_STORAGE=y
#CONFIG_BOOTSEL_FUNC_SCANFILE_SELF=y
```
